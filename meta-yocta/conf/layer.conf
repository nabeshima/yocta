## meta-yocta/conf/layer.conf
```bitbake
LAYERSERIES_COMPAT_meta-yocta = "sumo"

# We have a conf and classes directory, add to BBPATH
BBPATH .= ":${LAYERDIR}"

# We have recipes-* directories, add to BBFILES
BBFILES += "${LAYERDIR}/recipes-*/*/*.bb \
            ${LAYERDIR}/recipes-*/*/*.bbappend"

BBFILE_COLLECTIONS += "meta-yocta"
BBFILE_PATTERN_meta-yocta = "^${LAYERDIR}/"
BBFILE_PRIORITY_meta-yocta = "6"
```
